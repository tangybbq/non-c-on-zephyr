## CMakeLists.txt
```
# SPDX-License-Identifier: Apache-2.0

# Build a Zig project as an external project.  The build is done using
# zig build-obj, which will build the project into a single object
# file containing the entire Zig part of the program.

cmake_minimum_required(VERSION 3.13.1)

find_package(Zephyr REQUIRED HINTS $ENV{ZEPHYR_BASE})

project(zig_hello)

target_sources (app PRIVATE src/hooks.c)

include(ExternalProject)

set(zig_src_dir ${CMAKE_CURRENT_SOURCE_DIR})
set(zig_build_dir ${zig_src_dir})

ExternalProject_Add(
    zig_project
    PREFIX ${zig_build_dir}
    SOURCE_DIR ${zig_src_dir}
    BINARY_DIR ${zig_src_dir}
    CONFIGURE_COMMAND ""
    BUILD_COMMAND "zig" "build-obj"
       "-OReleaseSafe"
       "-target" "arm-freestanding-eabi" "-mcpu" "cortex_m33"
       "main.zig"
    INSTALL_COMMAND ""
    BUILD_ALWAYS True
    BUILD_BYPRODUCTS
      ${zig_src_dir}/main.o)

add_library(zig_lib STATIC IMPORTED GLOBAL)

add_dependencies(
    zig_lib
    zig_project
)
set_target_properties(zig_lib PROPERTIES IMPORTED_LOCATION
    ${zig_build_dir}/main.o)

target_link_libraries(app PUBLIC zig_lib)
```

## prj.conf
```kconfig
# CONFIG_CONSOLE_SUBSYS=y
# CONFIG_CONSOLE=y
# CONFIG_UART_CONSOLE=y
# CONFIG_CONSOLE_GETCHAR=y

CONFIG_PM=n
CONFIG_LOG=y
CONFIG_DEBUG=y
CONFIG_MAIN_STACK_SIZE=10240
CONFIG_LOG_MODE_MINIMAL=y
# CONFIG_LOG_DEFAULT_LEVEL=0
# CONFIG_LOG_MODE_IMMEDIATE=y
```

## src/hooks.c
```c
// SPDX-License-Identifier: Apache-2.0
/*
 * The Zephyr build system demands a source file in this directory.
 * This can be used for C interface stubs as they are needed.
 */

#include <zephyr/zephyr.h>
#include <string.h>

#define LOG_LEVEL LOG_LEVEL_INF
#include <zephyr/logging/log.h>
#include <zephyr/logging/log_ctrl.h>
LOG_MODULE_REGISTER(zig);

void zig_log_message(int level, const char *msg)
{
	switch (level) {
	case 0:
		LOG_ERR("%s", msg);
		break;
	case 1:
		LOG_WRN("%s", msg);
		break;
	case 2:
		LOG_INF("%s", msg);
		break;
	default:
		LOG_DBG("(%d) %s", level, msg);
	}
}

/* Because of conflicts between libgcc, and the llvm equivalent, we
 * will just define the functions that llvm wants as needed.
 * This could probably be made a lot more efficient, either in
 * code-size by using aliasing, or in performance, but having more
 * optimized versions of the '4' and '8' variants. */

/* Note that the arguments are in a different order than memset. */
void *__aeabi_memset(void *data, size_t n, int c)
{
	return memset(data, c, n);
}

void *__aeabi_memset4(void *data, size_t n, int c)
{
	return memset(data, c, n);
}
```
